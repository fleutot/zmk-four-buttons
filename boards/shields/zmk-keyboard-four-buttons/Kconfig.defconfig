## boards/shields/zmk-keyboard-four-buttons/Kconfig.defconfig
```kconfig
if SHIELD_FOUR_BUTTONS_LEFT

# Name must be less than 16 characters long!
config ZMK_KEYBOARD_NAME
    default "4buttons"

config ZMK_SPLIT_ROLE_CENTRAL
    default y

endif

if SHIELD_FOUR_BUTTONS_LEFT || SHIELD_FOUR_BUTTONS_RIGHT

config ZMK_SPLIT
    default y

endif
```

## boards/shields/zmk-keyboard-four-buttons/Kconfig.shield
```kconfig
# No whitespace after the comma or in your part name!
config SHIELD_FOUR_BUTTONS_LEFT
    def_bool $(shields_list_contains,four_buttons_left)

# No whitespace after the comma or in your part name!
config SHIELD_FOUR_BUTTONS_RIGHT
    def_bool $(shields_list_contains,four_buttons_right)
```
